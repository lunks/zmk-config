## Kconfig
```kconfig
DT_COMPAT_ZMK_BEHAVIOR_TRI_STATE := zmk,behavior-tri-state

config ZMK_BEHAVIOR_TRI_STATE
        bool
        default $(dt_compat_enabled,$(DT_COMPAT_ZMK_BEHAVIOR_TRI_STATE))

config ZEN_SPLIT_AUTO_UNPAIR_ON_KEY_MISMATCH
    bool "Clear a stale split bond when a split peripheral reports a missing key"
    depends on ZMK_SPLIT && ZMK_SPLIT_ROLE_CENTRAL
    help
      Out-of-tree port of zmkfirmware/zmk#3377. On a split central, if the security
      exchange with a peripheral fails with BT_SECURITY_ERR_PIN_OR_KEY_MISSING, drop the
      bond and disconnect so the next advertising window re-pairs from scratch.
      Needs the peripheral to accept re-pairing (ZMK_BLE_EXPERIMENTAL_SEC, already on).

config ZEN_SPLIT_BLE_IDLE_PARAMS
    bool "EXPERIMENTAL: slower split connection parameters while idle (port of zmk#3182)"
    depends on ZMK_SPLIT && ZMK_SPLIT_ROLE_CENTRAL
    help
      Off by default. Needs a Zephyr with the controller fix from zmkfirmware/zephyr#51 on
      every board (central and peripherals), otherwise a peripheral can assert on the update.
      Brief window (~0.6-1 s) of possible misordered keys when coming out of idle.

if ZEN_SPLIT_BLE_IDLE_PARAMS

config ZEN_SPLIT_BLE_IDLE_INT
    int "Idle connection interval (1.25 ms units)"
    default 18

config ZEN_SPLIT_BLE_IDLE_LATENCY
    int "Idle peripheral latency"
    default 10

config ZEN_SPLIT_BLE_IDLE_TIMEOUT
    int "Idle supervision timeout (10 ms units)"
    default 400

endif # ZEN_SPLIT_BLE_IDLE_PARAMS
```

## boards/shields/zen_dongle/Kconfig.defconfig
```kconfig
if SHIELD_ZEN_DONGLE

# Max 16 characters
config ZMK_KEYBOARD_NAME
    default "Corne-ish Zen"

config ZMK_SPLIT
    default y

config ZMK_SPLIT_ROLE_CENTRAL
    default y

# Left + right half
config ZMK_SPLIT_BLE_CENTRAL_PERIPHERALS
    default 2

# Peripherals + the default 5 BT host profiles
config BT_MAX_CONN
    default 7

config BT_MAX_PAIRED
    default 7

endif
```

## config/west.yml
```yaml
manifest:
  remotes:
    - name: zmkfirmware
      url-base: https://github.com/zmkfirmware
    - name: urob
      url-base: https://github.com/urob
  projects:
    # Pinned to a main commit: v0.3 predates Zephyr 4.1 / HWMv2 Zen boards.
    - name: zmk
      remote: zmkfirmware
      revision: 4dd95d7840eb3d5a3f59bb29fbf1ab054715ef85
      import: app/west.yml
    - name: zmk-helpers
      remote: urob
      revision: 7bcba18fc8df27303eb92a435d33ea870cc51f98
  self:
    path: config
```
